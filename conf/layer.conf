## conf/layer.conf
```bitbake
# We have a conf directory, append to BBPATH
BBPATH .= ":${LAYERDIR}"

# We have a recipes-* directory, add to BBFILES
BBFILES += "${LAYERDIR}/*/*/*.bb \
            ${LAYERDIR}/*/*/*.bbappend \
            ${LAYERDIR}/*/*.bb \
            ${LAYERDIR}/*/*.bbappend"

BBFILE_COLLECTIONS += "custom"
BBFILE_PATTERN_custom = "^${LAYERDIR}/"
BBFILE_PRIORITY_custom = "7"

IMAGE_FEATURES[validitems] += "x11-bare"
```

## conf/machine/xbox.conf
```bitbake
#@TYPE: Machine
#@NAME: xbox

#@DESCRIPTION: Machine configuration for xbox systems

PREFERRED_PROVIDER_virtual/kernel ?= "linux-xbox"


require conf/machine/include/tune-i586.inc


MACHINE_FEATURES += "efi pcbios"


XSERVER ?= "${XSERVER_X86_BASE} \
           ${XSERVER_X86_EXT} \
           ${XSERVER_X86_VESA} \
           "

MACHINE_EXTRA_RRECOMMENDS += "linux-firmware v86d "

EXTRA_OECONF_append_pn-matchbox-panel-2 = " --with-battery=acpi"

APPEND += "video=vesafb vga=0x318"

UBOOT_MACHINE = "microsoft-xbox_config"

LINUX_KERNEL_TYPE = "tiny"
KMACHINE_xbox = "common-pc"
KERNEL_IMAGETYPE = "bzImage"
```

## conf/machine/xjrad.conf
```bitbake
#@TYPE: Machine
#@NAME: xjrad

#@DESCRIPTION: Machine configuration for custom xj radio

MACHINEOVERRIDES =. "jetson-nano-devkit:"

require conf/machine/jetson-nano-devkit.conf

PREFERRED_VERSION_weston = "10.0.2"
PREFERRED_PROVIDER_virtual/kernel = "linux-xjrad"
KERNEL_DEVICETREE = "uglyoldbob/xjrad.dtb"

MACHINE_FEATURES:append = "bluetooth"

MACHINE_EXTRA_RDEPENDS = "kernel-modules nvgpu u-boot-script libglvnd networkmanager networkmanager-nmcli"

INITRAMFS_IMAGE = ""

KERNEL_ROOTSPEC = "root=b301"
KERNEL_ARGS = "console=ttyS0,115200 fbcon=map:0 net.ifnames=0"
```

## scripts/lib/wic/canned-wks/auto-radio.wks
```
part / --source rootfs --ondisk mmcblk2 --fstype=ext4 --label root --align 4 --mkfs-extraopts "-O ^orphan_file"
```

## scripts/lib/wic/canned-wks/sdimage-cyclone.wks
```
# short-description: Create SD card image for cyclone V soc
# long-description: Creates a partitioned SD card image for a cyclone V soc.

#--system-id=0xa2
part /PL --source rawcopy --sourceparams="file=whatever.bla" --ondisk mmcblk0 --fstype=vfat --label=pl --align 64 --size 16

part /boot --source bootimg-partition --ondisk mmcblk0 --fstype=vfat --label boot --active --align 64 --size 16

part / --source rootfs --ondisk mmcblk0 --fstype=ext4 --label root --align 8192 --size 1024
```
